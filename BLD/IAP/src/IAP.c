/*********************************************************************************
//概述：
//作者：随风飘跃     时间：       地点：
//CPU型号：         系统主频：
//版本号：V0.0        
*********************************************************************************/
/*********************************************************************************
文件包含区
*********************************************************************************/
#include "IAP.h"
/*********************************************************************************
常量定义区
*********************************************************************************/

/*********************************************************************************
公共变量定义区
*********************************************************************************/
/*********************************************************************************
外部变量声明区
*********************************************************************************/
/*********************************************************************************
私有变量定义区
*********************************************************************************/ 
//#pragma location=0x0F80
//uint32_t Vector_Table[32];
/*********************************************************************************
测试变量定义区
*********************************************************************************/
/*********************************************************************************
内部函数定义区
*********************************************************************************/
/*********************************************************************************
功能代码定义区
*********************************************************************************/
/*********************************************************************************
 Function:      //
 Description:   //保存BootLoader程序中断向量表
 Input:         //
                //
 Output:        //
 Return:      	//
 Others:        //
*********************************************************************************/
//uint32_t Vector[32] = {0};
//uint32_t Vector1[32] = {0};
void STM8_Interrupt_Vector_Table_Init(void)
{
  unsigned char i = 0,Index = 0;
  unsigned char version[11] = {0};
  uint32_t Vector[32] = {0};
  
  Read_Version(version);
  for(i = 0;i < 11;i++)
  {
    if(version[i] != BLD_VERSION[i])
    {
      Save_Version();
      
      FLASH_Unlock(FLASH_MemType_Program);    
      for(Index = 1; Index < 0X20;Index++)
      {
        Vector[Index] = FLASH_ReadWord(0X8000+4*Index);
      }
      FLASH_Lock(FLASH_MemType_Program);
      
      WriteRom (INTERRUPT_VECTOR_ADD,Vector,128);
      break;
    }
  }
//  for(Index = 0; Index < 0X20;Index++)
//  {
//    Vector1[Index] = *((const uint32_t *)(INTERRUPT_VECTOR_ADD+4*Index));
//  }
//  
}
/*********************************************************************************
 Function:      //
 Description:   //读FLASH地址数据
 Input:         //
                //
 Output:        //
 Return:      	//
 Others:        //
*********************************************************************************/
uint32_t FLASH_ReadWord(uint32_t Address)
{
 return(*(PointerAttr uint32_t *) (uint32_t)Address);       
}

/*********************************************************************************
 Function:      //
 Description:   ////重新初始化STM8的中断向量表  把它重新定义到APP的中断向量中
 Input:         //
                //
 Output:        //
 Return:      	//
 Others:        //
*********************************************************************************/
uint32_t aaa;
void STM8_Interrupt_Vector_Table_Redirection(void)
{
  disableInterrupts();   //关闭中断  
  uint8_t Index = 0;	
  
 
  FLASH_Unlock(FLASH_MemType_Program);
  for(Index = 1; Index < 0X20;Index++)
  {
    aaa = FLASH_ReadWord(0X8000+4*Index);
   if(FLASH_ReadWord(0X8000+4*Index)!=(0X82000000+APP_START_ADDR+Index*4))
   {
    FLASH_ProgramWord(0X8000+4*Index,0X82000000+APP_START_ADDR+Index*4);
   }
   aaa = FLASH_ReadWord(0X8000+4*Index);
  }
  FLASH_Lock(FLASH_MemType_Program);
}
/*********************************************************************************
 Function:      //
 Description:   //将升级包写入Flash
 Input:         //
                //
 Output:        //
 Return:      	//
 Others:        //
*********************************************************************************/
uint32_t addr = 0xE000;
ErrorStatus FlashWrite (void *pbuff, unsigned short length)
{
 unsigned short itemp;
 unsigned char *p; 
 unsigned short itemp16;
 
 do
 {FLASH_Unlock(FLASH_MemType_Program); }//开启FLASH编程
 while (FLASH_GetFlagStatus(FLASH_FLAG_PUL) == RESET); 
 itemp = 0;
 p = pbuff;
 while (itemp < length)
 {
   FLASH_ProgramByte(addr ,p[itemp]);
   itemp16 = 0xffff;
   while(FLASH_GetFlagStatus(FLASH_FLAG_EOP) == RESET)
   {
    itemp16 --;
    if(itemp16 <= 1)
    {
      FLASH_Lock(FLASH_MemType_Program);
      return ERROR;
    }
   }
   itemp16 = FLASH_ReadByte(addr);
   if(p[itemp] != itemp16)
   {
     FLASH_Lock(FLASH_MemType_Program);
     return ERROR;
   }
   else
   {itemp ++;addr++;}
 }
 FLASH_Lock(FLASH_MemType_Program);
 return SUCCESS;
}
/*********************************************************************************
 Function:      //
 Description:   //跳转到应用程序运行
 Input:         //
                //
 Output:        //
 Return:      	//
 Others:        //
*********************************************************************************/
void JumptoAPP(void)
{
  sim();               // disable interrupts，建议程序跳转前关中断，跳转到新程序后先清一次中断。
  asm("LDW X,  SP ");
  asm("LD  A,  $FF");
  asm("LD  XL, A  ");
  asm("LDW SP, X  ");
  asm("JPF $E000");
}
/*********************************************************************************
 Function:      //
 Description:   //
 Input:         //
                //
 Output:        //
 Return:      	//
 Others:        //
*********************************************************************************/

/*********************************************************************************
 Function:      //
 Description:   //
 Input:         //
                //
 Output:        //
 Return:      	//
 Others:        //
*********************************************************************************/

/*********************************************************************************
 Function:      //
 Description:   //
 Input:         //
                //
 Output:        //
 Return:      	//
 Others:        //
*********************************************************************************/

/*********************************************************************************
 Function:      //
 Description:   //
 Input:         //
                //
 Output:        //
 Return:      	//
 Others:        //
*********************************************************************************/

/*********************************************************************************
 Function:      //
 Description:   //
 Input:         //
                //
 Output:        //
 Return:	    	//
 Others:        //
*********************************************************************************/

/*********************************************************************************
 Function:      //
 Description:   //
 Input:         //
                //
 Output:        //
 Return:      	//
 Others:        //
*********************************************************************************/

/*********************************************************************************
 Function:      //
 Description:   //
 Input:         //
                //
 Output:        //
 Return:      	//
 Others:        //
*********************************************************************************/
/**************************************************************************
 Function:      //
 Description:   //
 Input:         //
                //
 Output:        //
 Return:      	//
 Others:        //
*********************************************************************************/

/*********************************************************************************
 Function:      //
 Description:   //
 Input:         //
                //
 Output:        //
 Return:      	//
 Others:        //
*********************************************************************************/

/*********************************************************************************
 Function:      //
 Description:   //
 Input:         //
                //
 Output:        //
 Return:      	//
 Others:        //
*********************************************************************************/

/*********************************************************************************
 Function:      //
 Description:   //
 Input:         //
                //
 Output:        //
 Return:      	//
 Others:        //
*********************************************************************************/
